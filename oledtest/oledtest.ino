#define SCL_PORT PORTC
#define SCL_PIN 5
#define SDA_PORT PORTC
#define SDA_PIN 4
#define I2C_TIMEOUT 100
#define I2C_FASTMODE 1
//#define I2C_NOINTERRUPT 1
#include <SoftI2CMaster.h>

#define SSD1306_I2C_ADDRESS 0x3C

//--------------------------------
/*
#include <Wire.h>
#include <avr/sleep.h>
#include <avr/wdt.h>
*/
/*#define SSD1306_SETCONTRAST 0x81
#define SSD1306_DISPLAYALLON_RESUME 0xA4
#define SSD1306_DISPLAYALLON 0xA5
#define SSD1306_NORMALDISPLAY 0xA6
#define SSD1306_INVERTDISPLAY 0xA7
#define SSD1306_DISPLAYOFF 0xAE
#define SSD1306_DISPLAYON 0xAF

#define SSD1306_SETDISPLAYOFFSET 0xD3
#define SSD1306_SETCOMPINS 0xDA

#define SSD1306_SETVCOMDETECT 0xDB

#define SSD1306_SETDISPLAYCLOCKDIV 0xD5
#define SSD1306_SETPRECHARGE 0xD9

#define SSD1306_SETMULTIPLEX 0xA8

#define SSD1306_SETLOWCOLUMN 0x00
#define SSD1306_SETHIGHCOLUMN 0x10

#define SSD1306_SETSTARTLINE 0x40

#define SSD1306_MEMORYMODE 0x20
#define SSD1306_COLUMNADDR 0x21
#define SSD1306_PAGEADDR   0x22

#define SSD1306_COMSCANINC 0xC0
#define SSD1306_COMSCANDEC 0xC8

#define SSD1306_SEGREMAP 0xA0

#define SSD1306_CHARGEPUMP 0x8D
#define SSD1306_EXTERNALVCC 0x1
#define SSD1306_SWITCHCAPVCC 0x2

// Scrolling #defines
#define SSD1306_ACTIVATE_SCROLL 0x2F
#define SSD1306_DEACTIVATE_SCROLL 0x2E
#define SSD1306_SET_VERTICAL_SCROLL_AREA 0xA3
#define SSD1306_RIGHT_HORIZONTAL_SCROLL 0x26
#define SSD1306_LEFT_HORIZONTAL_SCROLL 0x27
#define SSD1306_VERTICAL_AND_RIGHT_HORIZONTAL_SCROLL 0x29
#define SSD1306_VERTICAL_AND_LEFT_HORIZONTAL_SCROLL 0x2A
*/
const uint8_t font[] PROGMEM ={0xfc,0x7f,0xff,0x1f,0xfa,0x3f,0xfe,0x2f,0xf6,0x1f,0xfc,0x37,0x0e,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0x00,0x38};
const uint8_t ssd1306_128_32_init[] PROGMEM ={0xAE,0xD5,0x80,0xA8,0x1F,0xD3,0x00,0x40,0x8D,0x14,0x20,0x01,0xA1,0xC8,0xDA,0x02,0x81,0x8F,0xD9,0xF1,0xDB,0x40,0xA4,0xA6,0x2E,0xAF};

uint8_t i2a(int32_t value, uint8_t* result) {
    uint8_t* ptr = result, *ptr1 = result, tmp_char;
    uint8_t neg=0;
    uint8_t cnt=0;
    int32_t tmp_value;
    if(value<0) {neg=1;value=-value;}
    
    do {
      tmp_value = value;
      value /= 10;
      *ptr++ = '0'+tmp_value-value*10;
      cnt++;
    } while ( value );

    
    if (neg) {*ptr++ = '-';cnt++;}
    *ptr--;
    while(ptr1 < ptr) {
      tmp_char = *ptr;
      *ptr--= *ptr1;
      *ptr1++ = tmp_char;
    }
    return cnt;
}


uint8_t I2CWritePGM(uint8_t dev_addr, uint8_t reg_addr, const uint8_t *reg_data, uint16_t cnt)
{
  if(cnt==0) return 1;
  if(!i2c_start(dev_addr<<1 | I2C_WRITE)) return 0;
  if(!i2c_write(reg_addr)) return 0;
  for(uint16_t j=0;j<cnt;j++) if(!i2c_write(pgm_read_byte_near(reg_data+j))) return 0;
  i2c_stop();
  return 1;
}

uint8_t I2CWriteByte(uint8_t dev_addr, uint8_t reg_addr, uint8_t reg_data, uint16_t cnt)
{
  if(cnt==0) return 1;
  if(!i2c_start(dev_addr<<1 | I2C_WRITE)) return 0;
  if(!i2c_write(reg_addr)) return 0;
  for(uint16_t j=0;j<cnt;j++) if(!i2c_write(reg_data)) return 0;
  i2c_stop();
  return 1;
}

void char_pos_len(uint8_t c,uint16_t *pos,uint8_t *len)
{
    
    if(c>='0' && c<='9') {*pos=(c-'0')*52;*len=52;}
    else if(c=='R') {*pos=52*10+52*0;*len=52;}
    else if(c=='H') {*pos=52*10+52*1;*len=52;}
    else if(c=='C') {*pos=52*10+52*2;*len=52;}
    else if(c=='%') {*pos=52*10+52*3;*len=52;}
    else if(c=='-') {*pos=52*10+52*4;*len=52;}
    else if(c=='\'') {*pos=52*10+52*5;*len=12;}
    else if(c=='.') {*pos=52*10+52*5+1*12;*len=12;}
    else {*len=52;*pos=0xffff;}
}

uint16_t string_len(uint8_t *b)
{
  uint8_t i=0;
  uint8_t len;
  uint16_t pos;
  uint16_t lensum=0;

  while(b[i]) {char_pos_len(b[i],&pos,&len);lensum+=len+12;i++;}
  return lensum;
}

uint8_t ssd1306_command(uint8_t c)
{
  return I2CWriteByte(SSD1306_I2C_ADDRESS,0x00,c,1);
}

void ssd1306_init()
{
  for(uint8_t i=0;i<sizeof(ssd1306_128_32_init);i++) ssd1306_command(pgm_read_byte_near(ssd1306_128_32_init+i));
  /*
  ssd1306_command(SSD1306_DISPLAYOFF);                    // 0xAE
  
  ssd1306_command(SSD1306_SETDISPLAYCLOCKDIV);            // 0xD5
  ssd1306_command(0x80);                                  // the suggested ratio 0x80

  ssd1306_command(SSD1306_SETMULTIPLEX);                  // 0xA8
  ssd1306_command(32 - 1);

  ssd1306_command(SSD1306_SETDISPLAYOFFSET);              // 0xD3
  ssd1306_command(0x0);                                   // no offset
  
  //ssd1306_command(SSD1306_SETSTARTLINE | 0x0);            // line #0 0x40
  
  ssd1306_command(SSD1306_CHARGEPUMP);                    // 0x8D
  ssd1306_command(0x14);
  
  
  ssd1306_command(SSD1306_MEMORYMODE);                    // 0x20
  ssd1306_command(0x01);
  
  
  ssd1306_command(SSD1306_SEGREMAP | 0x1); //0xA1
  
  ssd1306_command(SSD1306_COMSCANDEC); //0xC8

  ssd1306_command(SSD1306_SETCOMPINS);                    // 0xDA
  ssd1306_command(0x02);
  
  ssd1306_command(SSD1306_SETCONTRAST);                   // 0x81
  ssd1306_command(0x8F);

  ssd1306_command(SSD1306_SETPRECHARGE);                  // 0xd9
  ssd1306_command(0xF1);
  
  ssd1306_command(SSD1306_SETVCOMDETECT);                 // 0xDB
  ssd1306_command(0x40);
  
  ssd1306_command(SSD1306_DISPLAYALLON_RESUME);           // 0xA4
  
  ssd1306_command(SSD1306_NORMALDISPLAY);                 // 0xA6

  ssd1306_command(SSD1306_DEACTIVATE_SCROLL); //0x2E

  ssd1306_command(SSD1306_DISPLAYON);//--turn on oled panel 0xAF
  */
}

void ssd1306_set()
{
  #define SSD1306_COLUMNADDR 0x21
  #define SSD1306_PAGEADDR   0x22
  
  ssd1306_command(SSD1306_COLUMNADDR);
  ssd1306_command(0x00);
  ssd1306_command(128-1);
  ssd1306_command(SSD1306_PAGEADDR);                                 
  ssd1306_command(0x00);
  ssd1306_command(32/8-1);
}
void ssd1306_clear()
{
  ssd1306_set();
  I2CWriteByte(SSD1306_I2C_ADDRESS,0x40,0xFF,512);
}

uint8_t ssd1306_char(uint8_t c)
{
    uint8_t len;
    uint16_t pos;
    char_pos_len(c,&pos,&len);
    
    if(pos!=0xffff) I2CWritePGM(SSD1306_I2C_ADDRESS,0x40,font+pos,len);
    else I2CWriteByte(SSD1306_I2C_ADDRESS,0x40,0,len);
    
    I2CWriteByte(SSD1306_I2C_ADDRESS,0x40,0,12);len+=12;
    return len;
}
void ssd1306_string(uint8_t *b)
{
  uint8_t i=0;
  
  ssd1306_set();
  I2CWriteByte(SSD1306_I2C_ADDRESS,0x40,0,512-string_len(b));
  while(b[i]) ssd1306_char(b[i++]);
  
}

void ssd1306_num(int32_t num)
{
  uint8_t buff[8];
  uint8_t n=i2a(num,buff);
  ssd1306_set();
  for(uint8_t i=0;i<n;i++) ssd1306_char(buff[i]);
  I2CWriteByte(SSD1306_I2C_ADDRESS,0x40,0,512-n*64);
  
}

unsigned long t;
void setup()
{
  //receiver
  pinMode(16,OUTPUT);
  digitalWrite(16,HIGH);

  //transmitter
  pinMode(15,OUTPUT);
  digitalWrite(15,HIGH);
  //digitalWrite(15,LOW);
  
  
  ssd1306_init();
  ssd1306_clear();
  //t=millis();
  //I2CWriteByte(SSD1306_I2C_ADDRESS,0x40,0xFF,512);
  //t=millis()-t;
}

void loop() {
  
  uint16_t v1=0,v2=0;
  
  v1+=analogRead(3);
  v1+=analogRead(3);
  v1+=analogRead(3);
  v1+=analogRead(3);
  v1+=analogRead(3);
  v1+=analogRead(3);
  v1+=analogRead(3);
  v1+=analogRead(3);
  digitalWrite(15,HIGH);
  delay(1);
  v2+=analogRead(3);
  v2+=analogRead(3);
  v2+=analogRead(3);
  v2+=analogRead(3);
  v2+=analogRead(3);
  v2+=analogRead(3);
  v2+=analogRead(3);
  v2+=analogRead(3);
  digitalWrite(15,LOW);
  
  //v1=(v1-v2)/8;
  //if(v1>1023) v1=0;
  
  ssd1306_num(1023-v1/8);
  //ssd1306_printnum(t);
  //char str[]="00000000";
  //uint16_t slen=string_len(str);
  //ssd1306_printnum(slen);
  //ssd1306_string("-1.3' C");
  delay(200);
}
