#include <avr/sleep.h>
#include <avr/wdt.h>

#define SCL_PORT PORTC
#define SCL_PIN 5
#define SDA_PORT PORTC
#define SDA_PIN 4
#define I2C_TIMEOUT 100
#define I2C_FASTMODE 1
//#define I2C_NOINTERRUPT 1
#include <SoftI2CMaster.h>

#define SSD1306_I2C_ADDR 0x3C
#define SHT31_I2C_ADDR 0x44

float stemp=99.9,shum=99;
uint8_t curstate=HIGH;
uint8_t th=1;

const uint8_t font[] PROGMEM ={0xfc,0x7f,0xff,0x1f,0xfa,0x3f,0xfe,0x2f,0xf6,0x1f,0xfc,0x37,0x0e,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0x00,0x38};
const uint8_t ssd1306_128_32_init[] PROGMEM ={0xAE,0xD5,0x80,0xA8,0x1F,0xD3,0x00,0x40,0x8D,0x14,0x20,0x01,0xA1,0xC8,0xDA,0x02,0x81,0x8F,0xD9,0xF1,0xDB,0x40,0xA4,0xA6,0x2E,0xAF};

int32_t rnd(float n)
{
  return (int32_t)(n > 0 ? n + 0.5 : n - 0.5);
}

uint8_t i2a(int32_t value, uint8_t* result) {
    uint8_t* ptr = result, *ptr1 = result, tmp_char;
    uint8_t neg=0;
    uint8_t cnt=0;
    int32_t tmp_value;
    if(value<0) {neg=1;value=-value;}
    
    do {
      tmp_value = value;
      value /= 10;
      *ptr++ = '0'+tmp_value-value*10;
      cnt++;
    } while ( value );

    
    if (neg) {*ptr++ = '-';cnt++;}
    *ptr--;
    while(ptr1 < ptr) {
      tmp_char = *ptr;
      *ptr--= *ptr1;
      *ptr1++ = tmp_char;
    }
    return cnt;
}

uint8_t I2CRead(uint8_t dev_addr, uint8_t reg_addr, uint8_t *reg_data, uint8_t cnt)
{
  if(cnt==0) return 1;
  if(!i2c_start(dev_addr<<1 | I2C_WRITE)) {i2c_stop();return 0;}
  if(!i2c_write(reg_addr)) {i2c_stop();return 0;}
  if(!i2c_rep_start(dev_addr<<1 | I2C_READ)) {i2c_stop();return 0;}
  for(uint8_t i=0;i<cnt;i++) reg_data[i]=i2c_read(i==cnt-1);
  i2c_stop();
  return 1;
}

uint8_t I2CWrite(uint8_t dev_addr, uint8_t reg_addr, uint8_t *reg_data, uint8_t cnt)
{
  if(!i2c_start(dev_addr<<1 | I2C_WRITE)) {i2c_stop();return 0;}
  if(!i2c_write(reg_addr)) {i2c_stop();return 0;}
  for(uint8_t j=0;j<cnt;j++) if(!i2c_write(reg_data[j])) {i2c_stop();return 0;}
  i2c_stop();
  return 1;
}

uint8_t I2CWritePGM(uint8_t dev_addr, uint8_t reg_addr, const uint8_t *reg_data, uint16_t cnt)
{
  if(cnt==0) return 1;
  if(!i2c_start(dev_addr<<1 | I2C_WRITE)) {i2c_stop();return 0;}
  if(!i2c_write(reg_addr)) {i2c_stop();return 0;}
  for(uint16_t j=0;j<cnt;j++) if(!i2c_write(pgm_read_byte_near(reg_data+j))) {i2c_stop();return 0;}
  i2c_stop();
  return 1;
}

uint8_t I2CWriteByte(uint8_t dev_addr, uint8_t reg_addr, uint8_t reg_data, uint16_t cnt)
{
  if(cnt==0) return 1;
  if(!i2c_start(dev_addr<<1 | I2C_WRITE)) {i2c_stop();return 0;}
  if(!i2c_write(reg_addr)) {i2c_stop();return 0;}
  for(uint16_t j=0;j<cnt;j++) if(!i2c_write(reg_data)) {i2c_stop();return 0;}
  i2c_stop();
  return 1;
}


void char_pos_len(uint8_t c,uint16_t *pos,uint8_t *len)
{
    
    if(c>='0' && c<='9') {*pos=(c-'0')*52;*len=52;}
    else if(c=='R') {*pos=52*10+52*0;*len=52;}
    else if(c=='H') {*pos=52*10+52*1;*len=52;}
    else if(c=='C') {*pos=52*10+52*2;*len=52;}
    else if(c=='%') {*pos=52*10+52*3;*len=52;}
    else if(c=='-') {*pos=52*10+52*4;*len=52;}
    else if(c=='\'') {*pos=52*10+52*5;*len=12;}
    else if(c=='.') {*pos=52*10+52*5+1*12;*len=12;}
    else {*len=52;*pos=0xffff;}
}

uint16_t string_len(uint8_t *b)
{
  uint8_t i=0;
  uint8_t len;
  uint16_t pos;
  uint16_t lensum=0;

  while(b[i]) {char_pos_len(b[i],&pos,&len);lensum+=len+12;i++;}
  return lensum;
}

uint8_t ssd1306_command(uint8_t c)
{
  return I2CWriteByte(SSD1306_I2C_ADDR,0x00,c,1);
}

void ssd1306_init()
{
  for(uint8_t i=0;i<sizeof(ssd1306_128_32_init);i++) ssd1306_command(pgm_read_byte_near(ssd1306_128_32_init+i));
}

void ssd1306_set()
{
  #define SSD1306_COLUMNADDR 0x21
  #define SSD1306_PAGEADDR   0x22
  
  ssd1306_command(SSD1306_COLUMNADDR);
  ssd1306_command(0x00);
  ssd1306_command(128-1);
  ssd1306_command(SSD1306_PAGEADDR);                                 
  ssd1306_command(0x00);
  ssd1306_command(32/8-1);
}
void ssd1306_clear()
{
  ssd1306_set();
  I2CWriteByte(SSD1306_I2C_ADDR,0x40,0x00,512);
}

uint8_t ssd1306_char(uint8_t c)
{
    uint8_t len;
    uint16_t pos;
    char_pos_len(c,&pos,&len);
    
    if(pos!=0xffff) I2CWritePGM(SSD1306_I2C_ADDR,0x40,font+pos,len);
    else I2CWriteByte(SSD1306_I2C_ADDR,0x40,0,len);
    
    I2CWriteByte(SSD1306_I2C_ADDR,0x40,0,12);len+=12;
    return len;
}
void ssd1306_string(uint8_t *b)
{
  uint8_t i=0;
  
  ssd1306_set();
  I2CWriteByte(SSD1306_I2C_ADDR,0x40,0,512-string_len(b));
  while(b[i]) ssd1306_char(b[i++]);
  
}


uint8_t readsht31()
{
  uint8_t readbuffer[6];
  
  if(!I2CWriteByte(SHT31_I2C_ADDR, 0x24, 0x00, 1)) return 0;
  delay(16);
  if(!I2CRead(SHT31_I2C_ADDR, 0x00, readbuffer, 6)) return 0;

  uint16_t ST, SRH;
  ST = readbuffer[0];
  ST <<= 8;
  ST |= readbuffer[1];
  SRH = readbuffer[3];
  SRH <<= 8;
  SRH |= readbuffer[4];

  stemp = ST;
  stemp *= 175;
  stemp /= 0xFFFF;
  stemp -= 45;
  
  shum = SRH;
  shum *= 100;
  shum /= 0xFFFF;
  
  return 1;
}


void gotosleep()
{
    
    set_sleep_mode (SLEEP_MODE_PWR_DOWN);
    noInterrupts();
    wdt_reset();
    WDTCSR = bit (WDCE) | bit (WDE);
    //WDTCSR = bit (WDIE) | 0b00100001;//8 sec
    WDTCSR = bit (WDIE) | 0b00000110;//1 sec
    sleep_enable();
    interrupts();
    sleep_cpu();
    sleep_disable();
    wdt_disable();
}

EMPTY_INTERRUPT (PCINT0_vect);
EMPTY_INTERRUPT (WDT_vect);

void setup()
{
  ADCSRA=0;
  
  pinMode(8, INPUT_PULLUP);
  PCICR = bit(PCIE0);
  PCMSK0 = bit(PCINT0);
  
  ssd1306_init();
  ssd1306_clear();
}

uint8_t checkbutton()
{
  uint8_t state;
  uint8_t lows=0;
  for(uint8_t i=0;i<=254;i++) if(digitalRead(8)==LOW) lows++;
  if(lows>=192) state=LOW;else state=HIGH;
  if(curstate!=state) {curstate=state;if(curstate==LOW) {th^=1;return 1;}}
  return 0;
}
void loop() {
  
  readsht31();
  
  uint8_t msg[9];
  int32_t t;
  uint8_t m,n;
  
  if(th)
  {
    t=rnd(stemp*10.0);
  
    n=i2a(t,msg);
    m=n+1;
  
    if(n==1 || (n==2 && t<0))
    {
      msg[n+1]=msg[n-1];msg[n-1]='0';msg[n]='.';
      m++;
    }
    else
    {
      msg[n]=msg[n-1];msg[n-1]='.';
    }
  
    msg[m++]='\'';msg[m++]=' ';msg[m++]='C';msg[m]=0;
  }
  else
  {
    t=rnd(shum);
    n=i2a(t,msg);
    m=n;
    msg[m++]='%';msg[m++]=' ';msg[m++]='R';msg[m++]='H';msg[m]=0;
  }
  
  ssd1306_string(msg);
  
  if(!checkbutton()){gotosleep();checkbutton();}
}
